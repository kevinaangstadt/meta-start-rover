## conf/bblayers.conf.sample
```bitbake
# POKY_BBLAYERS_CONF_VERSION is increased each time build/conf/bblayers.conf
# changes incompatibly
POKY_BBLAYERS_CONF_VERSION = "3"

BBPATH = "${TOPDIR}"
BBFILES ?= ""

BBLAYERS ?= " \
  ##OEROOT##/meta \
  ##OEROOT##/meta-poky \
  ##OEROOT##/meta-yocto-bsp \
  ##OEROOT##/meta-openembedded/meta-oe \
  ##OEROOT##/meta-openembedded/meta-python \
  ##OEROOT##/meta-openembedded/meta-networking \
  ##OEROOT##/meta-openembedded/meta-filesystems \
  ##OEROOT##/meta-virtualization \
  ##OEROOT##/meta-java \
  ##OEROOT##/meta-intel \
  ##OEROOT##/meta-up-board \
  ##OEROOT##/meta-start-rover \
  "
```

## conf/layer.conf
```bitbake
# We have a conf and classes directory, add to BBPATH
BBPATH .= ":${LAYERDIR}"

# We have a recipes-* directories, add to BBFILES
BBFILES += "${LAYERDIR}/recipes-*/*/*.bb \
	${LAYERDIR}/recipes-*/*/*.bbappend"

BBFILE_COLLECTIONS += "start-rover"
BBFILE_PATTERN_start-rover = "^${LAYERDIR}/"
BBFILE_PRIORITY_start-rover = "7"

LAYERDEPENDS_start-rover = "up-board"
```

## conf/machine/up-board-extra.conf
```bitbake
PREFERRED_PROVIDER_virtual/kernel ?= "linux-yocto-rt"

# don't wait to boot
GRUB_TIMEOUT = "3"

# APPEND += " rfkill.default_state=1"
```
